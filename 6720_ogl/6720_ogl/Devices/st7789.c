#include "st7789.h"
#include "tim.h"

#include <string.h>

uint16_t DMA_MIN_SIZE = 16;

const uint8_t reg_36[] = {0xA0,};   // {0xA0,}; {0x60,}; 倒屏
const uint8_t reg_B0[] = {0x00, 0xF8};
const uint8_t reg_B2[] = {0x0C, 0x0C, 0x00, 0x33, 0x33};
const uint8_t reg_B7[] = {0x35,};
const uint8_t reg_BB[] = {0x35,};
const uint8_t reg_C2[] = {0x01,};
const uint8_t reg_C3[] = {0x12,};
const uint8_t reg_C4[] = {0x20,};
const uint8_t reg_C6[] = {0x0F,};//刷新速度 0x09
const uint8_t reg_D0[] = {0xA4, 0xA2,};
const uint8_t reg_E0[] = {0xD0, 0x00, 0x02, 0x07, 0x0A, 0x28, 0x32, 0x44, 0x42, 0x06, 0x0E, 0x12, 0x14, 0x17};
const uint8_t reg_E1[] = {0xD0, 0x00, 0x02, 0x07, 0x0A, 0x28, 0x31, 0x54, 0x47, 0x0E, 0x1C, 0x17, 0x1B, 0x1E};
const uint8_t reg_3A[] = {0x55,};
const uint8_t reg_BA[] = {0x04,}; // Digital Gamma Enable

const uint8_t logo_ico[]  = { 0x00};
/*@注意：此文件由Image2Display生成，请保留此注释以便下次导入图片 */
/*@Size: 197x46, 00100 */
#if 0
const uint8_t logo_ico[]  = { 
/*@注意：此文件由Image2Display生成，请保留此注释以便下次导入图片 */
0x00,0x00,0x00,0x00,0x00,0x00,0x00,0x00,0x00,0x00,0x00,0x00,0x00,0x00,0x00,0x00,
0x00,0x00,0x00,0x00,0x00,0x00,0x00,0x00,0x00,0x00,0x00,0x00,0x00,0x00,0x00,0x00,
0x00,0x00,0x00,0x00,0x00,0x00,0x00,0x00,0x00,0x00,0x00,0x00,0x00,0x00,0x00,0x00,
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0x00,0x00,0x00,0x00,0x00,0x00,0x00,0x00,0x00,0x00,0x00,0x00,};







                                  
#endif

/* If you're using DMA, then u need a "framebuffer" to store datas to be displayed.
 * If your MCU don't have enough RAM, please avoid using DMA(or set 5 to 1).
 * And if your MCU have enough RAM(even larger than full-frame size),
 * Then you can specify the framebuffer size to the full resolution below.
 */
 #define HOR_LEN 	5	//	Also mind the resolution of your screen!

                                                              
  void SetBackLight(uint8_t pct)
{
    uint16_t ccr3;
    ccr3 = (uint16_t)((50000 - 1000) * (pct * 0.01) + 1000);
    htim1.Instance->CCR3 = ccr3;
}                                
                                  
                                  
                                  
/**
 * @brief Write command to ST7789 controller
 * @param cmd -> command to write
 * @return none
 */
static void ST7789_WriteCommand(uint8_t cmd)
{
	ST7789_Select();
	ST7789_DC_Clr();
	HAL_SPI_Transmit(&ST7789_SPI_PORT, &cmd, sizeof(cmd), HAL_MAX_DELAY);
	ST7789_UnSelect();
}

/**
 * @brief Write data to ST7789 controller
 * @param buff -> pointer of data buffer
 * @param buff_size -> size of the data buffer
 * @return none
 */
static void ST7789_WriteData(uint8_t *buff, size_t buff_size)
{
	ST7789_Select();
	ST7789_DC_Set();

	// split data in small chunks because HAL can't send more than 64K at once

	while (buff_size > 0) {
		uint16_t chunk_size = buff_size > 65535 ? 65535 : buff_size;
		#ifdef USE_DMA
			if (DMA_MIN_SIZE <= buff_size)
			{
				HAL_SPI_Transmit_DMA(&ST7789_SPI_PORT, buff, chunk_size);
				while (ST7789_SPI_PORT.hdmatx->State != HAL_DMA_STATE_READY)
				{}
			}
			else
				HAL_SPI_Transmit(&ST7789_SPI_PORT, buff, chunk_size, HAL_MAX_DELAY);
		#else
			HAL_SPI_Transmit(&ST7789_SPI_PORT, buff, chunk_size, HAL_MAX_DELAY);
		#endif
		buff += chunk_size;
		buff_size -= chunk_size;
	}

	ST7789_UnSelect();
}
/**
 * @brief Write data to ST7789 controller, simplify for 8bit data.
 * data -> data to write
 * @return none
 */
static void ST7789_WriteSmallData(uint8_t data)
{
	ST7789_Select();
	ST7789_DC_Set();
	HAL_SPI_Transmit(&ST7789_SPI_PORT, &data, sizeof(data), HAL_MAX_DELAY);
	ST7789_UnSelect();
}

/**
 * @brief Set the rotation direction of the display
 * @param m -> rotation parameter(please refer it in st7789.h)
 * @return none
 */


/**
 * @brief Set address of DisplayWindow
 * @param xi&yi -> coordinates of window
 * @return none
 */
static void ST7789_SetAddressWindow(uint16_t x0, uint16_t y0, uint16_t x1, uint16_t y1)
{
	ST7789_Select();
	uint16_t x_start = x0  , x_end = x1;
	uint16_t y_start = y0  , y_end = y1 ;
	
	/* Column Address set */
	ST7789_WriteCommand(ST7789_CASET); 
	{
		uint8_t data[] = {x_start >> 8, x_start & 0xFF, x_end >> 8, x_end & 0xFF};
		ST7789_WriteData(data, sizeof(data));
	}

	/* Row Address set */
	ST7789_WriteCommand(ST7789_RASET);
	{
		uint8_t data[] = {y_start >> 8, y_start & 0xFF, y_end >> 8, y_end & 0xFF};
		ST7789_WriteData(data, sizeof(data));
	}
	/* Write to RAM */
	ST7789_WriteCommand(ST7789_RAMWR);
	ST7789_UnSelect();
}


void DispPowerOnLogo(void)
{
    uint16_t width, height, str_x, str_y, end_x, end_y;
    // logo ico width,height...
  width  = 197;
  height = 46;
    // logo back x,y...

    // Write display Ram:logo back...
    ST7789_Fill_Color(BLACK);  
 //  HAL_Delay(100);
    // logo ico x,y...
    str_x = (320 - width)  / 2;
    str_y = (240 - height) / 2;
    end_x = str_x + width  - 1;
    end_y = str_y + height - 1;
    ST7789_SetAddressWindow(str_x, str_y, end_x, end_y);
    // Write display Ram:logo ico...
    ST7789_Select();
    ST7789_DC_Set();
  
    HAL_SPI_Transmit(&ST7789_SPI_PORT, (uint8_t *)(logo_ico), width * height * 2, HAL_MAX_DELAY);
    
    ST7789_UnSelect();
}



/**
 * @brief Initialize ST7789 controller
 * @param none
 * @return none
 */
void ST7789_Init(void)
{

    HAL_Delay(10);
    ST7789_RST_Clr();
    ST7789_DC_Set();
    HAL_Delay(10);
    ST7789_RST_Set();
    HAL_Delay(120);

  
    ST7789_WriteCommand(0x36);
    ST7789_WriteSmallData(*reg_36);

    ST7789_WriteCommand(0xB0);
    ST7789_WriteSmallData(*reg_B0);

    ST7789_WriteCommand(0xB2);
    ST7789_WriteSmallData(*reg_B2);

    ST7789_WriteCommand(0xB7);
    ST7789_WriteSmallData(*reg_B7);  

    ST7789_WriteCommand(0xBB);
    ST7789_WriteSmallData(*reg_BB);

    ST7789_WriteCommand(0xC2);
    ST7789_WriteSmallData(*reg_C2);

    ST7789_WriteCommand(0xC3);
    ST7789_WriteSmallData(*reg_C3);  

    ST7789_WriteCommand(0xC4);
    ST7789_WriteSmallData(*reg_C4);

    ST7789_WriteCommand(0xC6);
    ST7789_WriteSmallData(*reg_C6);

    ST7789_WriteCommand(0xD0);
    ST7789_WriteSmallData(*reg_D0);

    ST7789_WriteCommand(0xE0);
    ST7789_WriteSmallData(*reg_E0);

    ST7789_WriteCommand(0xE1);
    ST7789_WriteSmallData(*reg_E1);

    ST7789_WriteCommand(0x3A);
    ST7789_WriteSmallData(*reg_3A);

    ST7789_WriteCommand(0x11);

    HAL_Delay(150);
    
    ST7789_Fill_Color(BLACK);

    ST7789_WriteCommand(0x29);
    ST7789_WriteSmallData(0x00);
    HAL_Delay(150);
      
    ST7789_WriteCommand(0x36);
   ST7789_WriteSmallData(*reg_36);
    
   DispPowerOnLogo();//logo

    HAL_Delay(120); 
    
    HAL_TIM_PWM_Start(&htim1, TIM_CHANNEL_3);//背光
    for(uint8_t i = 0; i < 100; ++i) 
    {
        SetBackLight(i);
        HAL_Delay(10);
    }    


}

/**
 * @brief Fill the DisplayWindow with single color
 * @param color -> color to Fill with
 * @return none
 */
void ST7789_Fill_Color(uint16_t color)
{
	uint16_t i;
	ST7789_SetAddressWindow(0, 0, ST7789_WIDTH - 1, ST7789_HEIGHT - 1);
	ST7789_Select();
/*DAM_SPI*/  
//		for (i = 0; i < ST7789_HEIGHT / HOR_LEN; i++)
//		{
//			memset(disp_buf, color, sizeof(disp_buf));
//			ST7789_WriteData((uint8_t *)disp_buf, sizeof(disp_buf));
//		}
		uint16_t j;
		for (i = 0; i < ST7789_WIDTH; i++)
				for (j = 0; j < ST7789_HEIGHT; j++) {
					uint8_t data[] = {color >> 8, color & 0xFF};
					ST7789_WriteData(data, sizeof(data));
				}
	ST7789_UnSelect();
        
}

/**
 * @brief Draw a Pixel
 * @param x&y -> coordinate to Draw
 * @param color -> color of the Pixel
 * @return none
 */
void ST7789_DrawPixel(uint16_t x, uint16_t y, uint16_t color)
{
	if ((x < 0) || (x >= ST7789_WIDTH) ||
		 (y < 0) || (y >= ST7789_HEIGHT))	return;
	
	ST7789_SetAddressWindow(x, y, x, y);
	uint8_t data[] = {color >> 8, color & 0xFF};
	ST7789_Select();
	ST7789_WriteData(data, sizeof(data));
	ST7789_UnSelect();
}

/**
 * @brief Fill an Area with single color
 * @param xSta&ySta -> coordinate of the start point
 * @param xEnd&yEnd -> coordinate of the end point
 * @param color -> color to Fill with
 * @return none
 */
void ST7789_Fill(uint16_t xSta, uint16_t ySta, uint16_t xEnd, uint16_t yEnd, uint16_t color)
{
	if ((xEnd < 0) || (xEnd >= ST7789_WIDTH) ||
		 (yEnd < 0) || (yEnd >= ST7789_HEIGHT))	return;
	ST7789_Select();
	uint16_t i, j;
	ST7789_SetAddressWindow(xSta, ySta, xEnd, yEnd);
	for (i = ySta; i <= yEnd; i++)
		for (j = xSta; j <= xEnd; j++) {
			uint8_t data[] = {color >> 8, color & 0xFF};
			ST7789_WriteData(data, sizeof(data));
		}
	ST7789_UnSelect();
}


/**
 * @brief Draw an Image on the screen
 * @param x&y -> start point of the Image
 * @param w&h -> width & height of the Image to Draw
 * @param data -> pointer of the Image array
 * @return none
 */
void ST7789_DrawImage(uint16_t x, uint16_t y, uint16_t w, uint16_t h, const uint16_t *data)
{
	if ((x >= ST7789_WIDTH) || (y >= ST7789_HEIGHT))
		return;
	if ((x + w - 1) >= ST7789_WIDTH)
		return;
	if ((y + h - 1) >= ST7789_HEIGHT)
		return;

	ST7789_Select();
	ST7789_SetAddressWindow(x, y, x + w - 1, y + h - 1);
	ST7789_WriteData((uint8_t *)data, sizeof(uint16_t) * w * h);
	ST7789_UnSelect();
}


